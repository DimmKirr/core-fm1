## Kconfig
```kconfig
mainmenu "core-fm1 Firmware Configuration"

config FIRMWARE_NAME
    string "Firmware name"
    default "core-fm1"

config FIRMWARE_VERSION
    string "Firmware version"
    default "v0.0.0"

source "kconf/engines.kconfig"
source "kconf/effects.kconfig"
source "kconf/sequencer.kconfig"
source "kconf/scales.kconfig"

menu "System"

source "kconf/hal.kconfig"
source "kconf/boot.kconfig"
source "kconf/audio.kconfig"
source "kconf/midi.kconfig"
source "kconf/ui.kconfig"
source "kconf/storage.kconfig"
source "kconf/udisk.kconfig"
source "kconf/ble.kconfig"
source "kconf/wifi.kconfig"
source "kconf/cdp.kconfig"
source "kconf/debug.kconfig"
source "kconf/sys_menu.kconfig"

endmenu
```

## configs/core_fm1_dev_defconfig
```kconfig
CONFIG_FIRMWARE_NAME="core-fm1"
CONFIG_FIRMWARE_VERSION="v0.0.0"

#
# Engines
#
CONFIG_ENGINES=y

#
# Multi-upstream (require full audio core)
#
CONFIG_ENGINE_FM6=y
CONFIG_ENGINE_FM6_FMLAB=y
# CONFIG_ENGINE_FM6_FELUCCA is not set
# CONFIG_ENGINE_FM6_MELODEE is not set
# CONFIG_ENGINE_DRUM is not set

#
# Melodee
#
# CONFIG_ENGINE_PROPHET is not set
# CONFIG_ENGINE_CZ1 is not set
# CONFIG_ENGINE_SID is not set

#
# Felucca (MIT)
#
CONFIG_ENGINE_ANALOG=y
# CONFIG_ENGINE_DIGITAL is not set
# CONFIG_ENGINE_PHASE is not set
# CONFIG_ENGINE_SAMPLE is not set
# CONFIG_ENGINE_GRANULAR is not set
CONFIG_ENGINE_LOFI=y
CONFIG_ENGINE_TRIO=y
# CONFIG_ENGINE_TONEWHEEL is not set
# CONFIG_ENGINE_FORMANT is not set
# CONFIG_ENGINE_PHYSICAL is not set
CONFIG_ENGINE_NOISE=y

#
# Development
#
CONFIG_ENGINE_STUB=y
# end of Engines

#
# Effects
#
# CONFIG_EFFECTS_FELUCCA is not set
# CONFIG_EFFECTS_SLOOP is not set
CONFIG_EFFECTS_MELODEE=y
CONFIG_MODULATION=y
CONFIG_MOD_MELODEE=y
# CONFIG_MIX is not set
# end of Effects

#
# Sequencer
#
# CONFIG_SEQ_FELUCCA is not set
# CONFIG_SEQ_SLOOP is not set
CONFIG_SEQ_MELODEE=y
# end of Sequencer

#
# Scales
#
# CONFIG_SCALES_FELUCCA is not set
CONFIG_SCALES_MELODEE=y
# end of Scales

#
# System
#

#
# HAL
#

#
# Always included: fm1_adc.h, fm1_cc.h, fm1_gpio.h, fm1_xip.h, fm1_time.h
#
# CONFIG_HAL_SYS_FELUCCA is not set
# CONFIG_HAL_SYS_SLOOP is not set
CONFIG_HAL_SYS_MELODEE=y
# CONFIG_HAL_IRQ_FELUCCA is not set
# CONFIG_HAL_IRQ_SLOOP is not set
CONFIG_HAL_IRQ_MELODEE=y
# CONFIG_HAL_LCD_FELUCCA is not set
CONFIG_HAL_LCD_MELODEE=y
# CONFIG_HAL_INPUT_FELUCCA is not set
# CONFIG_HAL_INPUT_SLOOP is not set
CONFIG_HAL_INPUT_MELODEE=y
# CONFIG_HAL_GUARD_FELUCCA is not set
# CONFIG_HAL_GUARD_SLOOP is not set
CONFIG_HAL_GUARD_MELODEE=y
# CONFIG_HAL_FLASH_FELUCCA is not set
# CONFIG_HAL_FLASH_SLOOP is not set
CONFIG_HAL_FLASH_MELODEE=y
# CONFIG_HAL_UART_FELUCCA is not set
CONFIG_HAL_UART_MELODEE=y
# CONFIG_HAL_USB_FELUCCA is not set
CONFIG_HAL_USB_MELODEE=y
# CONFIG_HAL_TIMER_FELUCCA is not set
CONFIG_HAL_TIMER_MELODEE=y
# CONFIG_HAL_MULTICORE_FELUCCA is not set
# CONFIG_HAL_MULTICORE_SLOOP is not set
CONFIG_HAL_MULTICORE_MELODEE=y
CONFIG_HAL_MELODEE_CACHE=y
CONFIG_HAL_MELODEE_CLOCK=y
CONFIG_HAL_MELODEE_POWER=y
# end of HAL

#
# Boot
#
# CONFIG_BOOT_FELUCCA is not set
# CONFIG_BOOT_SLOOP is not set
CONFIG_BOOT_MELODEE=y
CONFIG_OTA=y
# end of Boot

#
# Audio
#
CONFIG_AUDIO=y
# CONFIG_DUAL_CORE is not set
# CONFIG_AUDIO_CORE_FELUCCA is not set
# CONFIG_AUDIO_CORE_SLOOP is not set
CONFIG_AUDIO_CORE_MELODEE=y
# CONFIG_AUDIO_24BIT is not set
# end of Audio

#
# MIDI
#
# CONFIG_MIDI_UART is not set
CONFIG_USB=y
# CONFIG_MIDI_FELUCCA is not set
# CONFIG_MIDI_SLOOP is not set
CONFIG_MIDI_MELODEE=y
# CONFIG_USB_AUDIO is not set
# CONFIG_EDITOR is not set
# CONFIG_CONSOLE is not set
# end of MIDI

#
# UI
#
CONFIG_INPUT=y
CONFIG_UI_FELUCCA=y
# CONFIG_UI_SLOOP is not set
# CONFIG_UI_CORE is not set
CONFIG_CONTROLS_FELUCCA=y
# CONFIG_CONTROLS_MELODEE is not set
# CONFIG_CONTROLS_SLOOP is not set
CONFIG_SPLASH_LOGO=y
# CONFIG_SPLASH_NONE is not set
CONFIG_GEN_FELUCCA_UI=y
# end of UI

#
# Storage
#
CONFIG_FLASH=y
# CONFIG_STORAGE_FELUCCA is not set
# CONFIG_STORAGE_SLOOP is not set
CONFIG_STORAGE_MELODEE=y
# end of Storage

#
# UDisk
#
CONFIG_USB_HOST=y
CONFIG_UDISK=y
# end of UDisk

#
# BLE
#
# CONFIG_BLE is not set
# end of BLE

#
# WiFi
#
CONFIG_WIFI=y
CONFIG_WIFI_LWIP=y
CONFIG_WIFI_WPA=y
CONFIG_WIFI_SSID=""
CONFIG_WIFI_PASSWORD=""
CONFIG_WIFI_AUTOJOIN=y
# CONFIG_WIFI_MIDI is not set
CONFIG_WIFI_MAC_OVERRIDE=""
CONFIG_WIFI_DEBUG_AUTOSCAN=y
CONFIG_WIFI_DEBUG_WLCTL0_PROBE=y
# CONFIG_WIFI_PROBES is not set
CONFIG_WIFI_T19_TEST=y
# end of WiFi

#
# CDP
#
# CONFIG_CDP is not set
# end of CDP

#
# Debug
#
CONFIG_DEBUG=y
CONFIG_DEBUG_LOG=y
CONFIG_DEBUG_DAP=y
# end of Debug

#
# Settings Menu
#
CONFIG_SYS_MENU=y
CONFIG_SETTINGS_FMLAB=y
# CONFIG_SETTINGS_FELUCCA is not set
# CONFIG_SETTINGS_NONE is not set
CONFIG_SETTINGS_AT=0xFC000
CONFIG_SYS_MENU_USB_MODE=y
CONFIG_SYS_MENU_MIDI_CH=y
# end of Settings Menu

#
# Scheduler
#
CONFIG_SCHED=y
CONFIG_SCHED_MAX_TASKS=6
CONFIG_SCHED_STACK_CANARY=y
# end of Scheduler
# end of System
```

## configs/felucca_mock_defconfig
```kconfig
CONFIG_FIRMWARE_NAME="felucca-mock"
CONFIG_HAL_SYS_MELODEE=y
CONFIG_HAL_IRQ_MELODEE=y
CONFIG_HAL_LCD_MELODEE=y
CONFIG_HAL_GUARD_MELODEE=y
CONFIG_HAL_MELODEE_CACHE=y
CONFIG_HAL_MELODEE_CLOCK=y
CONFIG_HAL_MELODEE_POWER=y
CONFIG_INPUT=y
CONFIG_UI_FELUCCA=y
# CONFIG_AUDIO is not set
# CONFIG_FLASH is not set
# CONFIG_MIDI_UART is not set
# CONFIG_USB is not set
# CONFIG_DUAL_CORE is not set
```

## configs/wifi_debug_defconfig
```kconfig
CONFIG_FIRMWARE_NAME="core-fm1"
CONFIG_FIRMWARE_VERSION="v0.0.0"

#
# Engines (stub only)
#
CONFIG_ENGINES=y
CONFIG_ENGINE_STUB=y

#
# Effects
#
# CONFIG_EFFECTS_FELUCCA is not set
# CONFIG_EFFECTS_SLOOP is not set
# CONFIG_EFFECTS_MELODEE is not set
# CONFIG_MODULATION is not set
# CONFIG_MIX is not set

#
# Sequencer
#
# CONFIG_SEQ_FELUCCA is not set
# CONFIG_SEQ_SLOOP is not set
# CONFIG_SEQ_MELODEE is not set

#
# Scales
#
# CONFIG_SCALES_FELUCCA is not set
# CONFIG_SCALES_MELODEE is not set

#
# System
#

#
# HAL
#
CONFIG_HAL_SYS_MELODEE=y
CONFIG_HAL_IRQ_MELODEE=y
CONFIG_HAL_LCD_MELODEE=y
CONFIG_HAL_INPUT_MELODEE=y
CONFIG_HAL_GUARD_MELODEE=y
CONFIG_HAL_FLASH_MELODEE=y
CONFIG_HAL_UART_MELODEE=y
CONFIG_HAL_USB_MELODEE=y
CONFIG_HAL_TIMER_MELODEE=y
CONFIG_HAL_MULTICORE_MELODEE=y
CONFIG_HAL_MELODEE_CACHE=y
CONFIG_HAL_MELODEE_CLOCK=y
CONFIG_HAL_MELODEE_POWER=y

#
# Boot
#
CONFIG_BOOT_MELODEE=y
CONFIG_OTA=y

#
# Audio
#
CONFIG_AUDIO=y
CONFIG_AUDIO_CORE_MELODEE=y

#
# MIDI (USB MIDI + SysEx debug)
#
CONFIG_USB=y
CONFIG_MIDI_MELODEE=y

#
# UI
#
CONFIG_INPUT=y
CONFIG_UI_FELUCCA=y
CONFIG_CONTROLS_FELUCCA=y
CONFIG_SPLASH_LOGO=y
CONFIG_GEN_FELUCCA_UI=y

#
# Storage (off)
#
CONFIG_FLASH=y

#
# UDisk (off)
#
# CONFIG_USB_HOST is not set
# CONFIG_UDISK is not set

#
# BLE
#
# CONFIG_BLE is not set

#
# WiFi
#
CONFIG_WIFI=y
CONFIG_WIFI_LWIP=y
CONFIG_WIFI_WPA=y
CONFIG_WIFI_PASSWORD=""

#
# Debug
#
CONFIG_DEBUG=y
CONFIG_DEBUG_LOG=y
CONFIG_DEBUG_DAP=y

#
# Settings Menu (off)
#
# CONFIG_SYS_MENU is not set

#
# Scheduler
#
CONFIG_SCHED=y
CONFIG_SCHED_MAX_TASKS=6
CONFIG_SCHED_STACK_CANARY=y
```

## configs/wifi_nonfree_defconfig
```kconfig
CONFIG_FIRMWARE_NAME="core-fm1"
CONFIG_FIRMWARE_VERSION="v0.0.0"

#
# Engines
#
CONFIG_ENGINES=y
# CONFIG_ENGINE_FM6 is not set
# CONFIG_ENGINE_ANALOG is not set
# CONFIG_ENGINE_LOFI is not set
# CONFIG_ENGINE_TRIO is not set
# CONFIG_ENGINE_NOISE is not set
CONFIG_ENGINE_STUB=y
# end of Engines

#
# Effects
#
# CONFIG_EFFECTS_MELODEE is not set
# CONFIG_MODULATION is not set
# end of Effects

#
# Sequencer
#
CONFIG_SEQ_MELODEE=y
# end of Sequencer

#
# Scales
#
CONFIG_SCALES_MELODEE=y
# end of Scales

#
# System
#

#
# HAL
#
CONFIG_HAL_SYS_MELODEE=y
CONFIG_HAL_IRQ_MELODEE=y
CONFIG_HAL_LCD_MELODEE=y
CONFIG_HAL_INPUT_MELODEE=y
CONFIG_HAL_GUARD_MELODEE=y
CONFIG_HAL_FLASH_MELODEE=y
CONFIG_HAL_UART_MELODEE=y
CONFIG_HAL_USB_MELODEE=y
CONFIG_HAL_TIMER_MELODEE=y
CONFIG_HAL_MULTICORE_MELODEE=y
CONFIG_HAL_MELODEE_CACHE=y
CONFIG_HAL_MELODEE_CLOCK=y
CONFIG_HAL_MELODEE_POWER=y
# end of HAL

#
# Boot
#
CONFIG_BOOT_MELODEE=y
CONFIG_OTA=y
# end of Boot

#
# Audio
#
CONFIG_AUDIO=y
CONFIG_AUDIO_CORE_MELODEE=y
# end of Audio

#
# MIDI
#
CONFIG_USB=y
CONFIG_MIDI_MELODEE=y
# end of MIDI

#
# UI
#
CONFIG_INPUT=y
CONFIG_UI_FELUCCA=y
CONFIG_CONTROLS_FELUCCA=y
CONFIG_SPLASH_LOGO=y
CONFIG_GEN_FELUCCA_UI=y
# end of UI

#
# Storage
#
CONFIG_FLASH=y
CONFIG_STORAGE_MELODEE=y
# end of Storage

#
# UDisk
#
CONFIG_USB_HOST=y
CONFIG_UDISK=y
# end of UDisk

#
# BLE
#
# CONFIG_BLE is not set
# end of BLE

#
# WiFi
#
# CONFIG_WIFI is not set
CONFIG_WIFI_NONFREE=y
# CONFIG_WIFI_PROBES is not set
# end of WiFi

#
# CDP
#
# CONFIG_CDP is not set
# end of CDP

#
# Debug
#
CONFIG_DEBUG=y
CONFIG_DEBUG_LOG=y
CONFIG_DEBUG_DAP=y
# end of Debug

#
# Settings Menu
#
CONFIG_SYS_MENU=y
CONFIG_SETTINGS_FMLAB=y
CONFIG_SETTINGS_AT=0xFC000
CONFIG_SYS_MENU_USB_MODE=y
CONFIG_SYS_MENU_MIDI_CH=y
# end of Settings Menu

#
# Scheduler
#
CONFIG_SCHED=y
CONFIG_SCHED_MAX_TASKS=6
CONFIG_SCHED_STACK_CANARY=y
# end of Scheduler
# end of System
```
